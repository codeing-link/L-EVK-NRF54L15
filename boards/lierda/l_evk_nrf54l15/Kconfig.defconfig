## boards/lierda/l_evk_nrf54l15/Kconfig.defconfig
```kconfig
# SPDX-License-Identifier: Apache-2.0

if BOARD_L_EVK_NRF54L15_NRF54L15_CPUAPP

config HAS_BT_CTLR
	default BT

config HW_STACK_PROTECTION
	default ARCH_HAS_STACK_PROTECTION

endif # BOARD_L_EVK_NRF54L15_NRF54L15_CPUAPP
```

## boards/lierda/l_evk_nrf54l15/board.yml
```yaml
board:
  name: l_evk_nrf54l15
  full_name: L-EVK-NRF54L15
  vendor: lierda
  socs:
    - name: nrf54l15
runners:
  run_once:
    '--recover':
      - runners:
          - nrfjprog
          - nrfutil
        run: first
        groups:
          - boards:
              - l_evk_nrf54l15/nrf54l15/cpuapp
    '--erase':
      - runners:
          - nrfjprog
          - jlink
          - nrfutil
        run: first
        groups:
          - boards:
              - l_evk_nrf54l15/nrf54l15/cpuapp
    '--reset':
      - runners:
          - nrfjprog
          - jlink
          - nrfutil
        run: last
        groups:
          - boards:
              - l_evk_nrf54l15/nrf54l15/cpuapp
```

## boards/lierda/l_evk_nrf54l15/l_evk_nrf54l15_nrf54l15_cpuapp_defconfig
```kconfig
# SPDX-License-Identifier: Apache-2.0

CONFIG_SERIAL=y
CONFIG_CONSOLE=y
CONFIG_UART_CONSOLE=y
CONFIG_GPIO=y
CONFIG_ARM_MPU=y
CONFIG_NRF_GRTC_START_SYSCOUNTER=y
CONFIG_REGULATOR=y
```

## boards/others/l_evk_nrf54l15/Kconfig
```kconfig
config BOARD_L_EVK_NRF54L15
	select SOC_NRF54L15_CPUAPP if BOARD_L_EVK_NRF54L15_NRF54L15_CPUAPP
```

## boards/others/l_evk_nrf54l15/board.yml
```yaml
board:
  name: l_evk_nrf54l15
  full_name: L-EVK-NRF54L15
  vendor: others
  socs:
    - name: nrf54l15
```

## sysbuild/mcuboot/boards/l_evk_nrf54l15_nrf54l15_cpuapp.conf
```kconfig
# MCUboot settings for L-EVK-NRF54L15.
CONFIG_FPROTECT=n
CONFIG_MAIN_STACK_SIZE=16384
CONFIG_FLASH=y
CONFIG_BOOT_MAX_IMG_SECTORS_AUTO=y
CONFIG_MULTITHREADING=y
CONFIG_LOG=y
CONFIG_LOG_MODE_MINIMAL=y
CONFIG_LOG_DEFAULT_LEVEL=0
CONFIG_MCUBOOT_LOG_LEVEL_INF=y
CONFIG_CBPRINTF_NANO=y
CONFIG_MINIMAL_LIBC=y
CONFIG_NCS_APPLICATION_BOOT_BANNER_STRING="MCUboot"

# The application owns UART30 after MCUboot transfers control.
CONFIG_SERIAL=n
CONFIG_CONSOLE=n
CONFIG_UART_CONSOLE=n
```
