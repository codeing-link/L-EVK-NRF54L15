/* SPDX-License-Identifier: Apache-2.0 */

/dts-v1/;

#include <nordic/nrf54l15_cpuapp.dtsi>
#include "l_evk_nrf54l15_common.dtsi"
#include <vendor/nordic/nrf54l15_cpuapp_partition.dtsi>
#include "l_evk_nrf54l15_partition.dtsi"

/ {
	model = "L-EVK-NRF54L15";
	compatible = "lierda,l-evk-nrf54l15-nrf54l15-cpuapp";

	chosen {
		zephyr,code-partition = &slot0_partition;
		zephyr,sram = &cpuapp_sram;
	};
};
